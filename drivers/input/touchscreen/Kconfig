## drivers/input/touchscreen/Kconfig
```kconfig
#
# Touchscreen driver configuration
#
menuconfig INPUT_TOUCHSCREEN
	bool "Touchscreens"
	help
	  Say Y here, and a list of supported touchscreens will be displayed.
	  This option doesn't affect the kernel.

	  If unsure, say Y.

if INPUT_TOUCHSCREEN

config TOUCHSCREEN_FT5X06
       tristate "FocalTech touchscreens"
       depends on I2C
       help
         Say Y here if you have a ft5X06 touchscreen.
	 Ft5x06 controllers are multi touch controllers which can
	 report 5 touches at a time.

         If unsure, say N.

         To compile this driver as a module, choose M here: the
         module will be called ft5x06_ts.

config TOUCHSCREEN_FT5X06_CALIBRATE
        bool "calibrate after flash firmware"
        depends on TOUCHSCREEN_FT5X06
        default y
        help
          must turn off after all pre-production device get upgrade.

config TOUCHSCREEN_FT5X06_TYPEB
        bool "use type B for touch report"
        depends on TOUCHSCREEN_FT5X06
        default y
        help
          enable typeB for multi-touch report.

config TOUCHSCREEN_FT5X06_I2C
        tristate "Focaltech FT5X0X I2C touchscreens"
        depends on I2C
        select TOUCHSCREEN_FT5X0X
        help
          Say Y here if you have a Focaltech FT5X0X I2C touchscreen connected
          to your system.

          If unsure, say N.

          To compile this driver as a set of modules, choose M here: the
          modules will be called ft5x0x_ts_i2c.

config TOUCHSCREEN_FT5X06_SPI
        tristate "Focaltech FT5X0X SPI touchscreens"
        depends on SPI
        select TOUCHSCREEN_FT5X0X
        help
          Say Y here if you have a Focaltech FT5X0X SPI touchscreen connected
          to your system.

          If unsure, say N.

          To compile this driver as a set of modules, choose M here: the
          modules will be called ft5x0x_ts_spi.

config TOUCHSCREEN_GEN_VKEYS
       tristate "Touchscreen Virtual Keys Driver"
       help
         Say Y here if you want to generate a sysfs entry for virtual
	 keys on Android.

         If unsure, say N.

         To compile this driver as a module, choose M here: the
         module will be called gen_vkeys.

config TOUCHSCREEN_GT9XX
	bool "Goodix touchpanel GT9xx series"
	depends on I2C
	help
	  Say Y here if you have a Goodix GT9xx touchscreen.
	  Gt9xx controllers are multi touch controllers which can
	  report 5 touches at a time.

          If unsure, say N.

config TOUCHSCREEN_IST30XX
        bool "Imagis touchpanel ist30xx series"
        depends on I2C
        help
          Say Y here if you have a Imagis ist30xx touchscreen.
	  Ist30xx controllers are multi touch controllers which can
          report 10 touches at a time.

          If unsure, say N.

config TOUCHSCREEN_SWEEP2WAKE
        tristate "Sweep2Wake for CYTTSP_I2C based touchscreens"
        depends on I2C
        default y

source "drivers/input/touchscreen/gt9xx/Kconfig"

endif
```

## drivers/media/radio/Kconfig
```kconfig
#
# Multimedia Video device configuration
#

menuconfig RADIO_ADAPTERS
	bool "Radio Adapters"
	depends on VIDEO_V4L2
	default y
	---help---
	  Say Y here to enable selecting AM/FM radio adapters.

if RADIO_ADAPTERS && VIDEO_V4L2

config RADIO_IRIS
        tristate "Qualcomm IRIS FM support"
        depends on VIDEO_V4L2
        default n
        ---help---
          Say Y here if you want to use the Qualcomm FM chip (IRIS).
          This FM chip uses SMD interface

          To compile this driver as a module, choose M here: the
          module will be called radio-iris.


config RADIO_IRIS_TRANSPORT
        tristate "Qualcomm IRIS Transport"
        depends on RADIO_IRIS
        default n
        ---help---
          Say Y here if you want to use the Qualcomm FM chip (IRIS).
          with SMD as transport.

          To compile this driver as a module, choose M here: the
          module will be called radio-iris-transport.

endif # RADIO_ADAPTERS
```

## drivers/net/Kconfig
```kconfig
#
# Network device configuration
#

menuconfig NETDEVICES
	default y if UML
	depends on NET
	bool "Network device support"
	---help---
	  You can say N here if you don't intend to connect your Linux box to
	  any other computer at all.

	  You'll have to say Y if your computer contains a network card that
	  you want to use under Linux. If you are going to run SLIP or PPP over
	  telephone line or null modem cable you need say Y here. Connecting
	  two machines with parallel ports using PLIP needs this, as well as
	  AX.25/KISS for sending Internet traffic over amateur radio links.

	  See also "The Linux Network Administrator's Guide" by Olaf Kirch and
	  Terry Dawson. Available at <http://www.tldp.org/guides.html>.

	  If unsure, say Y.

# All the following symbols are dependent on NETDEVICES - do not repeat
# that for each of the symbols.
if NETDEVICES

config NET_CORE
	default y
	bool "Network core driver support"
	---help---
	  You can say N here if you do not intend to use any of the
	  networking core drivers (i.e. VLAN, bridging, bonding, etc.)

if NET_CORE

config DUMMY
	tristate "Dummy net driver support"
	---help---
	  This is essentially a bit-bucket device (i.e. traffic you send to
	  this device is consigned into oblivion) with a configurable IP
	  address. It is most commonly used in order to make your currently
	  inactive SLIP address seem like a real address for local programs.
	  If you use SLIP or PPP, you might want to say Y here. Since this
	  thing often comes in handy, the default is Y. It won't enlarge your
	  kernel either. What a deal. Read about it in the Network
	  Administrator's Guide, available from
	  <http://www.tldp.org/docs.html#guide>.

	  To compile this driver as a module, choose M here: the module
	  will be called dummy.  If you want to use more than one dummy
	  device at a time, you need to compile this driver as a module.
	  Instead of 'dummy', the devices will then be called 'dummy0',
	  'dummy1' etc.

config NET_FC
	bool "Fibre Channel driver support"
	depends on SCSI && PCI
	help
	  Fibre Channel is a high speed serial protocol mainly used to connect
	  large storage devices to the computer; it is compatible with and
	  intended to replace SCSI.

	  If you intend to use Fibre Channel, you need to have a Fibre channel
	  adaptor card in your computer; say Y here and to the driver for your
	  adaptor below. You also should have said Y to "SCSI support" and
	  "SCSI generic support".

config MII
	tristate "Generic Media Independent Interface device support"
	help
	  Most ethernet controllers have MII transceiver either as an external
	  or internal device.  It is safe to say Y or M here even if your
	  ethernet card lacks MII.

source "drivers/ieee802154/Kconfig"

config TUN
	tristate "Universal TUN/TAP device driver support"
	select CRC32
	---help---
	  TUN/TAP provides packet reception and transmission for user space
	  programs.  It can be viewed as a simple Point-to-Point or Ethernet
	  device, which instead of receiving packets from a physical media,
	  receives them from user space program and instead of sending packets
	  via physical media writes them to the user space program.

	  When a program opens /dev/net/tun, driver creates and registers
	  corresponding net device tunX or tapX.  After a program closed above
	  devices, driver will automatically delete tunXX or tapXX device and
	  all routes corresponding to it.

	  Please read <file:Documentation/networking/tuntap.txt> for more
	  information.

	  To compile this driver as a module, choose M here: the module
	  will be called tun.

	  If you don't know what to use this for, you don't need it.

endif # NET_CORE

source "drivers/atm/Kconfig"

source "drivers/net/ethernet/Kconfig"

source "drivers/net/ppp/Kconfig"

source "drivers/net/slip/Kconfig"

source "drivers/s390/net/Kconfig"

source "drivers/net/usb/Kconfig"

source "drivers/net/wireless/Kconfig"

endif # NETDEVICES
```

## sound/soc/Kconfig
```kconfig
#
# SoC audio configuration
#

menuconfig SND_SOC
	tristate "ALSA for SoC audio support"
	select SND_PCM
	select AC97_BUS if SND_SOC_AC97_BUS
	select SND_JACK if INPUT=y || INPUT=SND
	select REGMAP_I2C if I2C
	select REGMAP_SPI if SPI_MASTER
	select SND_COMPRESS_OFFLOAD
	---help---

	  If you want ASoC support, you should say Y here and also to the
	  specific driver for your SoC platform below.
	  
	  ASoC provides power efficient ALSA support for embedded battery powered
	  SoC based systems like PDA's, Phones and Personal Media Players.

	  This ASoC audio support can also be built as a module.  If so, the module
	  will be called snd-soc-core.

if SND_SOC

config SND_SOC_AC97_BUS
	bool

config SND_SOC_DMAENGINE_PCM
	bool

# All the supported SoCs
source "sound/soc/msm/Kconfig"

# Supported codecs
source "sound/soc/codecs/Kconfig"

endif	# SND_SOC
```
